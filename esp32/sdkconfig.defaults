## esp32/sdkconfig.defaults
```kconfig
CONFIG_PARTITION_TABLE_CUSTOM=y
CONFIG_PARTITION_TABLE_CUSTOM_FILENAME="partitions.csv"
CONFIG_ZB_ENABLED=y
CONFIG_ZB_ZED=y
CONFIG_BOOTLOADER_SKIP_VALIDATE_IN_DEEP_SLEEP=y
CONFIG_ESPTOOLPY_FLASHMODE_DIO=y
CONFIG_ESPTOOLPY_FLASHFREQ_64M=y
# CONFIG_ESP_DEFAULT_CPU_FREQ_160 not available in IDF 5.5
CONFIG_ESP_CONSOLE_USB_SERIAL_JTAG=n

# Size optimizations
CONFIG_COMPILER_OPTIMIZATION_SIZE=y
CONFIG_COMPILER_OPTIMIZATION_ASSERTIONS_DISABLE=y
CONFIG_COMPILER_OPTIMIZATION_ASSERTION_LEVEL=0
CONFIG_COMPILER_OPTIMIZATION_CHECKS_SILENT=y
CONFIG_LOG_DEFAULT_LEVEL_ERROR=y
CONFIG_LOG_MAXIMUM_LEVEL_ERROR=y
CONFIG_BOOTLOADER_LOG_LEVEL_ERROR=y
# CONFIG_LOG_DYNAMIC_LEVEL_CONTROL is not set
CONFIG_HAL_DEFAULT_ASSERTION_LEVEL=0
# CONFIG_ESP_ERR_TO_NAME_LOOKUP is not set
CONFIG_ESP_CONSOLE_NONE=y
CONFIG_ESP_CONSOLE_SECONDARY_NONE=y
# CONFIG_ESP_SYSTEM_HW_PC_RECORD is not set
CONFIG_APP_EXCLUDE_PROJECT_VER_VAR=y
CONFIG_APP_EXCLUDE_PROJECT_NAME_VAR=y
# CONFIG_FREERTOS_INTERRUPT_BACKTRACE is not set
# CONFIG_ESP_NETIF_REPORT_DATA_TRAFFIC is not set

# ===== Strip TCP/IP (keep headers for compile deps, linker dead-strips code) =====
CONFIG_LWIP_ENABLE=y
CONFIG_LWIP_IPV4=y
CONFIG_LWIP_IPV6=y
# CONFIG_LWIP_TCP is not set
# CONFIG_LWIP_UDP is not set
# CONFIG_LWIP_RAW is not set
# CONFIG_LWIP_SOCKET is not set
# CONFIG_LWIP_NETCONN is not set
# CONFIG_LWIP_NETIF_API is not set
# CONFIG_LWIP_DHCP is not set
# CONFIG_LWIP_DNS is not set
# CONFIG_LWIP_SNTP is not set
# CONFIG_LWIP_ICMP is not set
# CONFIG_LWIP_SO_REUSE is not set
# CONFIG_LWIP_ESP_GRATUITOUS_ARP is not set
# CONFIG_LWIP_ESP_MLDV6_REPORT is not set
# CONFIG_LWIP_IP4_FRAG is not set
# CONFIG_LWIP_IP6_FRAG is not set
# CONFIG_LWIP_NETIF_LOOPBACK is not set
# CONFIG_LWIP_NETIF_STATUS_CALLBACK is not set
CONFIG_LWIP_MAX_SOCKETS=0
CONFIG_LWIP_MAX_ACTIVE_TCP=0
CONFIG_LWIP_MAX_LISTENING_TCP=0
CONFIG_LWIP_MAX_UDP_PCBS=0
CONFIG_LWIP_MAX_RAW_PCBS=0
CONFIG_LWIP_NUM_NETIF_CLIENT_DATA=0
CONFIG_LWIP_IPV6_NUM_ADDRESSES=1
CONFIG_LWIP_IPV6_MEMP_NUM_ND6_QUEUE=1
CONFIG_LWIP_IPV6_ND6_NUM_NEIGHBORS=1
CONFIG_LWIP_IPV6_ND6_NUM_PREFIXES=1
CONFIG_LWIP_IPV6_ND6_NUM_ROUTERS=1
CONFIG_LWIP_IPV6_ND6_NUM_DESTINATIONS=1
CONFIG_LWIP_TCPIP_RECVMBOX_SIZE=4
CONFIG_LWIP_TCP_RECVMBOX_SIZE=0
CONFIG_LWIP_UDP_RECVMBOX_SIZE=0
CONFIG_LWIP_TCPIP_TASK_STACK_SIZE=1024

# ===== Strip WiFi (H2 has no WiFi radio) =====
CONFIG_ESP_WIFI_ENABLED=n

# ===== Strip Bluetooth =====
CONFIG_BT_ENABLED=n

# ===== Strip coexistence =====
CONFIG_ESP_COEX_ENABLED=n

# ===== Strip certificate bundle (Zigbee doesn't use TLS) =====
CONFIG_MBEDTLS_CERTIFICATE_BUNDLE=n

# ===== Minimal mbedTLS (Zigbee SDK needs AES-CCM + ECC, not full TLS) =====
CONFIG_MBEDTLS_SSL_PROTO_TLS1_2=y
# CONFIG_MBEDTLS_SSL_PROTO_TLS1_3 is not set
# CONFIG_MBEDTLS_SSL_RENEGOTIATION is not set
# CONFIG_MBEDTLS_SSL_ALPN is not set
# CONFIG_MBEDTLS_CLIENT_SSL_SESSION_TICKETS is not set
# CONFIG_MBEDTLS_SERVER_SSL_SESSION_TICKETS is not set
# CONFIG_MBEDTLS_PEM_PARSE_C is not set
# CONFIG_MBEDTLS_PEM_WRITE_C is not set
# CONFIG_MBEDTLS_X509_CRL_PARSE_C is not set
# CONFIG_MBEDTLS_X509_CSR_PARSE_C is not set

# ===== Strip unused mbedTLS curves =====
CONFIG_MBEDTLS_ECP_DP_BP256R1_ENABLED=n
CONFIG_MBEDTLS_ECP_DP_BP384R1_ENABLED=n
CONFIG_MBEDTLS_ECP_DP_BP512R1_ENABLED=n
CONFIG_MBEDTLS_ECP_DP_SECP192K1_ENABLED=n
CONFIG_MBEDTLS_ECP_DP_SECP224K1_ENABLED=n
CONFIG_MBEDTLS_ECP_DP_CURVE25519_ENABLED=n

# ===== Strip DPA side-channel hardening =====
CONFIG_ESP_CRYPTO_DPA_PROTECTION_AT_STARTUP=n

# ===== Use nano printf/scanf (no float support, saves ~15KB) =====
CONFIG_LIBC_NEWLIB_NANO_FORMAT=y

# ===== Save/restore via libcalls instead of inline =====
CONFIG_COMPILER_SAVE_RESTORE_LIBCALLS=y
```
